## app/boards/shields/lets_split/Kconfig.defconfig
```kconfig
if SHIELD_LETS_SPLIT_LEFT

config ZMK_KEYBOARD_NAME
	default "Let's Split Left"

endif

if SHIELD_LETS_SPLIT_RIGHT

config ZMK_KEYBOARD_NAME
	default "Let's Split Right"

endif
```
